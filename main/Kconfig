## main/Kconfig
```kconfig
menu "ESP32 MQTT RELAY"
    
config ESP_WIFI_SSID
    string "WiFi SSID"
    default "vodafone60D0"
    help
    SSID (network name) for the example to connect to.

config ESP_WIFI_PASSWORD
    string "WiFi Password"
    default ""
    help
    WiFi password (WPA or WPA2) for the example to use.


config ESP_MQTT_URI
    string "MQTT URI"
    default ""
    help
    MQTT URI

config ESP_MQTT_USERNAME
    string "MQTT User"
    default ""
    help
    MQTT username


config ESP_MQTT_PASSWORD
    string "MQTT Password"
    default ""
    help
    MQTT password
endmenu
```
